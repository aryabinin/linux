## lib/Kconfig.kasan
```kconfig
config HAVE_ARCH_KASAN
	bool

if HAVE_ARCH_KASAN

config KASAN
	bool "AddressSanitizer: runtime memory debugger"
	help
	  Enables address sanitizer - runtime memory debugger,
	  designed to find out-of-bounds accesses and use-after-free bugs.
	  This is strictly debugging feature. It consumes about 1/8
	  of available memory and brings about ~x3 performance slowdown.
	  For better error detection enable CONFIG_STACKTRACE,
	  and add slub_debug=U to boot cmdline.
endif
```
